## main/Kconfig.projbuild
```kconfig
menu "Board Configuration"

    choice BOARD_TYPE
        prompt "Board Type"
        default BOARD_TYPE_LC_SZP_DEV
        config BOARD_TYPE_LC_SZP_DEV
            bool "立创实战派s3开发板"
        config BOARD_TYPE_LC_SZP_C3_DEV
            bool "立创实战派c3开发板"
    endchoice

    
    choice PROTOCOL_TYPE
    prompt "Protocol Type"
    default PROTOCOL_TYPE_WEBSOCKET
    help
        网络数据传输协议
    config PROTOCOL_TYPE_WEBSOCKET
        bool "Websocket"
    endchoice

    config WEBSOCKET_URL
    depends on PROTOCOL_TYPE_WEBSOCKET
    string "Websocket URL"
    default "ws://192.168.10.25:8000/"


    choice WAKE_WORD_TYPE
    prompt "Wake Type"
    default WAKE_WORD_DETECT_TYPE
    help
        唤醒类型
    config WAKE_WORD_DETECT_TYPE
        bool "唤醒词检测"
    config CMD_WORD_DETECT_TYPE
        bool "命令词检测"
    endchoice
    
endmenu
```
